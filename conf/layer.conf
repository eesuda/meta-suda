## conf/layer.conf
```bitbake
# We have a conf and classes directory, add to BBPATH
BBPATH .= ":${LAYERDIR}"

LICENSE_PATH += "${LAYERDIR}/licenses"

# We have a recipes-* directories, add to BBFILES
BBFILES += "${LAYERDIR}/recipes-*/*/*.bb \
	${LAYERDIR}/recipes-*/*/*.bbappend"

BBFILE_COLLECTIONS += "suda"
BBFILE_PATTERN_suda = "^${LAYERDIR}/"
BBFILE_PRIORITY_suda = "10"
```

## conf/machine/tele.conf
```bitbake
#@TYPE: Machine
#@NAME: tele
#@DESCRIPTION: Machine configuration for tele systems
SOC_FAMILY = "omap3"
require conf/machine/include/soc-family.inc

# PREFERRED_PROVIDER_virtual/xserver ?= "xserver-xorg"
# XSERVER ?= "xserver-xorg \
#            xf86-input-evdev \
#            xf86-input-mouse \
#            xf86-video-omapfb \
#            xf86-input-keyboard"

# Default to external video, change to smallscreen for built-in LCD
# MACHINE_GUI_CLASS = "smallscreen"
# MACHINE_EXTRA_RRECOMMENDS = " kernel-modules kernel-devicetree"

# EXTRA_IMAGEDEPENDS += "u-boot"

DEFAULTTUNE ?= "cortexa8hf-neon"
include conf/machine/include/tune-cortexa8.inc

IMAGE_FSTYPES += "tar.bz2"

SERIAL_CONSOLE = "115200 ttyO2"

PREFERRED_PROVIDER_virtual/kernel ?= "linux-suda"
PREFERRED_VERSION_linux-suda ?= "4.4%"

# KERNEL_IMAGETYPE = "zImage"
# KERNEL_DEVICETREE = "omap3-teledm.dtb"
# KERNEL_EXTRA_ARGS += "LOADADDR=${UBOOT_ENTRYPOINT}"
# 
# SPL_BINARY = "MLO"
# UBOOT_SUFFIX = "img"
# UBOOT_MACHINE = "omap3_beagle_config"
# UBOOT_ENTRYPOINT = "0x80008000"
# UBOOT_LOADADDRESS = "0x80008000"
# 
# MACHINE_FEATURES = "usbhost vfat"
# 
# IMAGE_BOOT_FILES ?= "u-boot.${UBOOT_SUFFIX} MLO"
```
